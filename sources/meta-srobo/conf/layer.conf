## sources/meta-srobo/conf/layer.conf
```bitbake
# We have a conf and classes directory, add to BBPATH
BBPATH .= ":${LAYERDIR}"

# We have recipes-* directories, add to BBFILES
BBFILES += "${LAYERDIR}/recipes-*/*/*.bb \
            ${LAYERDIR}/recipes-*/*/*.bbappend"

BBFILE_COLLECTIONS += "meta-srobo"
BBFILE_PATTERN_meta-srobo = "^${LAYERDIR}/"
BBFILE_PRIORITY_meta-srobo = "6"

LAYERDEPENDS_meta-srobo = "core"
LAYERSERIES_COMPAT_meta-srobo = "kirkstone"
```
